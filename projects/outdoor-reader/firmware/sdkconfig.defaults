## projects/outdoor-reader/firmware/sdkconfig.defaults
```kconfig
CONFIG_ESPTOOLPY_FLASHSIZE_4MB=y
CONFIG_COMPILER_OPTIMIZATION_SIZE=y
CONFIG_FREERTOS_HZ=1000
CONFIG_ESP_MAIN_TASK_STACK_SIZE=12288
CONFIG_LOG_DEFAULT_LEVEL_INFO=y
CONFIG_PN532_IRQ=-1
CONFIG_PN532_SCK=18
CONFIG_PN532_SS=21
CONFIG_PN532_MISO=19
CONFIG_PN532_MOSI=23
```
